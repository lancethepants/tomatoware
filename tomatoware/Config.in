## tomatoware/Config.in
```kconfig
menu "Tomatoware"
	source "$BR2_EXTERNAL_TOMATOWARE_PATH/package/native-gcc/Config.in"
	source "$BR2_EXTERNAL_TOMATOWARE_PATH/package/m4-target/Config.in"
	source "$BR2_EXTERNAL_TOMATOWARE_PATH/package/bison-target/Config.in"
	source "$BR2_EXTERNAL_TOMATOWARE_PATH/package/autoconf-target/Config.in"
	source "$BR2_EXTERNAL_TOMATOWARE_PATH/package/automake-target/Config.in"
	source "$BR2_EXTERNAL_TOMATOWARE_PATH/package/ninja-target/Config.in"
	source "$BR2_EXTERNAL_TOMATOWARE_PATH/package/meson-target/Config.in"
	source "$BR2_EXTERNAL_TOMATOWARE_PATH/package/ccache-target/Config.in"
	source "$BR2_EXTERNAL_TOMATOWARE_PATH/package/upx-target/Config.in"
	source "$BR2_EXTERNAL_TOMATOWARE_PATH/package/mold/Config.in"
	source "$BR2_EXTERNAL_TOMATOWARE_PATH/package/distcc/Config.in"
	source "$BR2_EXTERNAL_TOMATOWARE_PATH/package/slibtool/Config.in"
	source "$BR2_EXTERNAL_TOMATOWARE_PATH/package/mandoc/Config.in"
endmenu
```

## tomatoware/configs/arm-ft_defconfig
```kconfig
BR2_arm=y
BR2_cortex_a9=y
BR2_TOOLCHAIN_BUILDROOT_VENDOR="tomatoware"
BR2_TOOLCHAIN_BUILDROOT_MUSL=y
BR2_KERNEL_HEADERS_VERSION=y
BR2_DEFAULT_KERNEL_VERSION="2.6.36.4"
BR2_GCC_VERSION_16_X=y
BR2_TOOLCHAIN_BUILDROOT_CXX=y
BR2_GCC_ENABLE_OPENMP=y
BR2_DL_DIR="~/buildroot-src"
BR2_CCACHE=y
BR2_SHARED_STATIC_LIBS=y
BR2_GLOBAL_PATCH_DIR="$(BR2_EXTERNAL_TOMATOWARE_PATH)/patches/ $(BR2_EXTERNAL_TOMATOWARE_PATH)/patches-ft2636/"
BR2_ROOTFS_SKELETON_CUSTOM=y
BR2_ROOTFS_SKELETON_CUSTOM_PATH="$(BR2_EXTERNAL_TOMATOWARE_PATH)/board/common/skeleton"
BR2_INIT_NONE=y
BR2_ROOTFS_MERGED_USR=y
BR2_TARGET_TZ_INFO=y
BR2_ROOTFS_POST_IMAGE_SCRIPT="$(BR2_EXTERNAL_TOMATOWARE_PATH)/board/common/post-image.sh"
BR2_ROOTFS_POST_IMAGE_SCRIPT_ARGS="arm-ft"
# BR2_PACKAGE_BUSYBOX is not set
BR2_PACKAGE_GZIP=y
BR2_PACKAGE_P7ZIP=y
BR2_PACKAGE_P7ZIP_7ZA=y
BR2_PACKAGE_UNRAR=y
BR2_PACKAGE_UNZIP=y
BR2_PACKAGE_GDB=y
BR2_PACKAGE_GDB_DEBUGGER=y
BR2_PACKAGE_GDB_TUI=y
BR2_PACKAGE_STRACE=y
BR2_PACKAGE_CHECK=y
BR2_PACKAGE_CMAKE_CTEST=y
BR2_PACKAGE_DIFFUTILS=y
BR2_PACKAGE_FINDUTILS=y
BR2_PACKAGE_FLEX=y
BR2_PACKAGE_GAWK=y
BR2_PACKAGE_GIT=y
BR2_PACKAGE_GREP=y
BR2_PACKAGE_LIBTOOL=y
BR2_PACKAGE_MAKE=y
BR2_PACKAGE_PATCH=y
BR2_PACKAGE_PKGCONF=y
BR2_PACKAGE_SED=y
BR2_PACKAGE_CPIO=y
BR2_PACKAGE_LUA=y
BR2_PACKAGE_PYTHON3=y
BR2_PACKAGE_PYTHON3_PY_ONLY=y
BR2_PACKAGE_PYTHON3_BZIP2=y
BR2_PACKAGE_PYTHON3_CODECSCJK=y
BR2_PACKAGE_PYTHON3_CURSES=y
BR2_PACKAGE_PYTHON3_DECIMAL=y
BR2_PACKAGE_PYTHON3_READLINE=y
BR2_PACKAGE_PYTHON3_SQLITE=y
BR2_PACKAGE_PYTHON3_XZ=y
BR2_PACKAGE_PYTHON3_ZSTD=y
BR2_PACKAGE_PYTHON_PIP=y
BR2_PACKAGE_TCL=y
# BR2_PACKAGE_TCL_DEL_ENCODINGS is not set
# BR2_PACKAGE_TCL_SHLIB_ONLY is not set
BR2_PACKAGE_LZ4=y
BR2_PACKAGE_LZ4_PROGS=y
BR2_PACKAGE_LZO=y
BR2_PACKAGE_CA_CERTIFICATES=y
BR2_PACKAGE_GNUTLS=y
BR2_PACKAGE_GNUTLS_TOOLS=y
BR2_PACKAGE_LIBMD=y
BR2_PACKAGE_LIBOPENSSL_BIN=y
BR2_PACKAGE_BERKELEYDB=y
BR2_PACKAGE_BERKELEYDB_DBM=y
BR2_PACKAGE_BERKELEYDB_TOOLS=y
BR2_PACKAGE_GDBM=y
BR2_PACKAGE_UNIXODBC=y
BR2_PACKAGE_LIBXSLT=y
BR2_PACKAGE_LIBCURL_CURL=y
BR2_PACKAGE_LIBPCAP=y
BR2_PACKAGE_BOOST=y
BR2_PACKAGE_BOOST_COROUTINE=y
BR2_PACKAGE_BOOST_EXCEPTION=y
BR2_PACKAGE_BOOST_GRAPH=y
BR2_PACKAGE_BOOST_IOSTREAMS=y
BR2_PACKAGE_BOOST_JSON=y
BR2_PACKAGE_BOOST_LOG=y
BR2_PACKAGE_BOOST_MATH=y
BR2_PACKAGE_BOOST_PROGRAM_OPTIONS=y
BR2_PACKAGE_BOOST_RANDOM=y
BR2_PACKAGE_BOOST_SERIALIZATION=y
BR2_PACKAGE_BOOST_SYSTEM=y
BR2_PACKAGE_BOOST_TEST=y
BR2_PACKAGE_BOOST_URL=y
BR2_PACKAGE_LIBGLIB2=y
BR2_PACKAGE_LIBUCONTEXT=y
BR2_PACKAGE_LINUX_PAM=y
BR2_PACKAGE_LIBEDIT=y
BR2_PACKAGE_OPENSSH=y
# BR2_PACKAGE_OPENSSH_SERVER is not set
BR2_PACKAGE_RSYNC=y
BR2_PACKAGE_WGET=y
BR2_PACKAGE_BASH=y
BR2_PACKAGE_ZSH=y
BR2_PACKAGE_FILE=y
BR2_PACKAGE_GNUPG2=y
BR2_PACKAGE_SCREEN=y
BR2_PACKAGE_TMUX=y
BR2_PACKAGE_WHICH=y
BR2_PACKAGE_COREUTILS=y
BR2_PACKAGE_HTOP=y
BR2_PACKAGE_PROCPS_NG=y
BR2_PACKAGE_TAR=y
BR2_PACKAGE_UTIL_LINUX=y
BR2_PACKAGE_UTIL_LINUX_BINARIES=y
BR2_PACKAGE_NANO=y
BR2_PACKAGE_VIM=y
# BR2_TARGET_ROOTFS_TAR is not set
BR2_PACKAGE_NATIVE_GCC=y
BR2_PACKAGE_BISON_TARGET=y
BR2_PACKAGE_AUTOMAKE_TARGET=y
BR2_PACKAGE_MESON_TARGET=y
BR2_PACKAGE_CCACHE_TARGET=y
BR2_PACKAGE_UPX_TARGET=y
BR2_PACKAGE_MOLD=y
BR2_PACKAGE_DISTCC=y
BR2_PACKAGE_SLIBTOOL=y
BR2_PACKAGE_MANDOC=y
```

## tomatoware/package/autoconf-target/Config.in
```kconfig
config BR2_PACKAGE_AUTOCONF_TARGET
	bool "autoconf"
	depends on BR2_USE_MMU # perl
	select BR2_PACKAGE_M4_TARGET # runtime
	select BR2_PACKAGE_PERL # runtime
	help
	  GNU autoconf, built for the target.

	  https://www.gnu.org/software/autoconf/
```

## tomatoware/package/automake-target/Config.in
```kconfig
config BR2_PACKAGE_AUTOMAKE_TARGET
	bool "automake"
	depends on BR2_USE_MMU # perl
	select BR2_PACKAGE_AUTOCONF_TARGET # runtime
	select BR2_PACKAGE_PERL # runtime
	help
	  GNU automake, built for the target.

	  https://www.gnu.org/software/automake/
```

## tomatoware/package/bison-target/Config.in
```kconfig
config BR2_PACKAGE_BISON_TARGET
	bool "bison"
	depends on BR2_USE_WCHAR
	depends on BR2_USE_MMU # fork()
	select BR2_PACKAGE_M4_TARGET # runtime
	help
	  GNU parser generator, built for the target.

	  https://www.gnu.org/software/bison/
```

## tomatoware/package/ccache-target/Config.in
```kconfig
config BR2_PACKAGE_CCACHE_TARGET
	bool "ccache"
	depends on BR2_INSTALL_LIBSTDCPP
	depends on BR2_TOOLCHAIN_GCC_AT_LEAST_8 # C++20, blake3
	depends on BR2_TOOLCHAIN_HAS_THREADS
	select BR2_PACKAGE_BLAKE3
	select BR2_PACKAGE_XXHASH
	select BR2_PACKAGE_ZSTD
	help
	  Compiler cache, built for the target.

	  https://ccache.dev/
```

## tomatoware/package/distcc/Config.in
```kconfig
config BR2_PACKAGE_DISTCC
	bool "distcc"
	depends on BR2_USE_MMU # fork()
	help
	  distcc distributes compilation of C and C++ code across
	  several machines on a network.

	  https://www.distcc.org/
```

## tomatoware/package/m4-target/Config.in
```kconfig
config BR2_PACKAGE_M4_TARGET
	bool "m4"
	depends on BR2_USE_WCHAR
	depends on BR2_USE_MMU # fork()
	help
	  GNU m4 macro processor, built for the target.

	  https://www.gnu.org/software/m4/
```

## tomatoware/package/mandoc/Config.in
```kconfig
config BR2_PACKAGE_MANDOC
	bool "mandoc"
	depends on BR2_USE_MMU # fork()
	depends on BR2_USE_WCHAR
	select BR2_PACKAGE_ZLIB
	select BR2_PACKAGE_MUSL_FTS if !BR2_TOOLCHAIN_USES_GLIBC
	select BR2_PACKAGE_LESS # runtime, the pager
	help
	  mandoc formats manual pages; it provides man, apropos,
	  whatis and makewhatis.

	  https://mandoc.bsd.lv/
```

## tomatoware/package/meson-target/Config.in
```kconfig
config BR2_PACKAGE_MESON_TARGET
	bool "meson"
	depends on BR2_PACKAGE_PYTHON3
	select BR2_PACKAGE_NINJA_TARGET # runtime
	help
	  Meson build system, built for the target.

	  https://mesonbuild.com/
```

## tomatoware/package/mold/Config.in
```kconfig
config BR2_PACKAGE_MOLD
	bool "mold"
	depends on BR2_INSTALL_LIBSTDCPP
	depends on BR2_TOOLCHAIN_GCC_AT_LEAST_10 # C++20
	depends on BR2_TOOLCHAIN_HAS_THREADS
	depends on !BR2_STATIC_LIBS # mold-wrapper.so
	select BR2_PACKAGE_ZLIB
	select BR2_PACKAGE_ZSTD
	help
	  mold is a faster drop-in replacement for the GNU linker.

	  This is the 2.x series, the last one written in C++; 3.0
	  was rewritten in Rust.

	  https://github.com/rui314/mold
```

## tomatoware/package/native-gcc/Config.in
```kconfig
config BR2_PACKAGE_NATIVE_GCC
	bool "native-gcc"
	depends on BR2_TOOLCHAIN_BUILDROOT_MUSL
	depends on BR2_INSTALL_LIBSTDCPP
	depends on !BR2_STATIC_LIBS
	select BR2_PACKAGE_BINUTILS
	select BR2_PACKAGE_BINUTILS_TARGET
	select BR2_PACKAGE_GMP
	select BR2_PACKAGE_MPFR
	select BR2_PACKAGE_MPC
	select BR2_PACKAGE_ZLIB
	select BR2_PACKAGE_ZSTD
	help
	  GCC built to run on the target and produce code for the
	  target, from the same source and patches as the Buildroot
	  cross compiler.
```

## tomatoware/package/ninja-target/Config.in
```kconfig
config BR2_PACKAGE_NINJA_TARGET
	bool "ninja"
	depends on BR2_INSTALL_LIBSTDCPP
	depends on BR2_USE_MMU # fork()
	help
	  Ninja build system, built for the target.

	  https://ninja-build.org/
```

## tomatoware/package/slibtool/Config.in
```kconfig
config BR2_PACKAGE_SLIBTOOL
	bool "slibtool"
	depends on BR2_USE_MMU # fork()
	help
	  A skinny, fast libtool replacement written in C.

	  https://dev.midipix.org/cross/slibtool
```

## tomatoware/package/upx-target/Config.in
```kconfig
config BR2_PACKAGE_UPX_TARGET
	bool "upx"
	depends on BR2_INSTALL_LIBSTDCPP
	help
	  The Ultimate Packer for eXecutables, built for the target.

	  https://upx.github.io/
```
